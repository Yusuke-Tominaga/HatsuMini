## config/west.yml
```yaml
# manifest:
#   remotes:
#     - name: zmkfirmware
#       url-base: https://github.com/petejohanson
#     - name: inorichi
#       url-base: https://github.com/inorichi
#   projects:
#     - name: zmk
#       remote: zmkfirmware
#       revision: feat/pointers-move-scroll
#       import: app/west.yml
#     - name: zmk-pmw3610-driver
#       remote: inorichi
#       revision: main
#   self:
#     path: config
manifest:
  remotes:
    - name: zmkfirmware
      url-base: https://github.com/zmkfirmware          # ★ 公式リポに変更
    - name: inorichi
      url-base: https://github.com/inorichi

  projects:
    - name: zmk
      remote: zmkfirmware
      revision: main                                    # ★ main ブランチ
      import: app/west-zephyr.yml                       # ★ ← main 用パス
    - name: zmk-pmw3610-driver
      remote: inorichi
      revision: main

  self:
    path: config
```
